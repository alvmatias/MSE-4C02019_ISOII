## Conf/bblayers.conf
```bitbake
# POKY_BBLAYERS_CONF_VERSION is increased each time build/conf/bblayers.conf
# changes incompatibly
POKY_BBLAYERS_CONF_VERSION = "2"

BBPATH = "${TOPDIR}"
BBFILES ?= ""

BBLAYERS ?= " \
  /home/cscovino/Matias/yocto-labs/poky/meta \
  /home/cscovino/Matias/yocto-labs/poky/meta-poky \
  /home/cscovino/Matias/yocto-labs/meta-ti \
  /home/cscovino/Matias/yocto-labs/meta-custom \
  "
```
